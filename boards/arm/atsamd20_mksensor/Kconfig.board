## boards/arm/atsamd20_mksensor/Kconfig.board
```kconfig
# Kconfig - SAM D20 Maker Sensor Board configuration
#
# Copyright (c) 2018 Sean Nyekjaer
# SPDX-License-Identifier: Apache-2.0

config BOARD_ATSAMD20_MKSENSOR
	bool "SAM D20 Maker-Sensor"
	depends on SOC_PART_NUMBER_SAMD20E18
```

## boards/arm/atsamd20_mksensor/Kconfig.defconfig
```kconfig
# Kconfig - SAM D20 Maker Sensor board configuration
#
# Copyright (c) 2018 Sean Nyekjaer
# SPDX-License-Identifier: Apache-2.0

if BOARD_ATSAMD20_MKSENSOR

config BOARD
	default atsamd20_mksensor

endif # BOARD_ATSAMD20_MKSENSOR
```

## boards/arm/atsamd20_mksensor/atsamd20_mksensor_defconfig
```kconfig
CONFIG_ARM=y
CONFIG_SOC_FAMILY_SAM0=y
CONFIG_SOC_SERIES_SAMD20=y
CONFIG_SOC_PART_NUMBER_SAMD20E18=y
CONFIG_BOARD_ATSAMD20_MKSENSOR=y
CONFIG_CORTEX_M_SYSTICK=y
CONFIG_CONSOLE=y
CONFIG_UART_CONSOLE=y
CONFIG_SERIAL=y
CONFIG_UART_SAM0=y
CONFIG_UART_INTERRUPT_DRIVEN=y
CONFIG_GPIO=y
CONFIG_GPIO_SAM0=y
CONFIG_WATCHDOG=y
CONFIG_WDT_SAM0=y
CONFIG_SOC_ATMEL_SAMD_OSC8M_AS_MAIN=y
CONFIG_PINMUX=y
CONFIG_PINMUX_SAM0=y
```
